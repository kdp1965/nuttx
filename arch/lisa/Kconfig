## arch/lisa/src/common/Kconfig
```kconfig
#
# For a description of the syntax of this configuration file,
# see the file kconfig-language.txt in the NuttX tools repository.
#

if ARCH_LISA

config LISA_SPI
	bool "SPI master"
	default n
	select SPI
	---help---
		The third chip's SPI master (ttsky26d RESPIN 29, peripheral
		0x228-0x22B) as SPI bus 0 (lisa_spibus_initialize(0)): a byte at a
		time, polled, modes 0-3, the clock clk / (2 (DIV + 1)).  The
		select is the device id's index: SPIDEV_xxx(0) is CS0, (1) CS1.
		The pins come from the uo_out mux (debug register 0x1b, set by the
		host: 0x2880 puts CS0 / SCLK / MOSI on uo[3] / uo[5] / uo[6], CS1
		is uo[7] under mux 0) and MISO from the input LISA_SPI_MISO names.

if LISA_SPI

config LISA_SPI_MISO
	int "MISO input: 0 = ui_in[0], 1 = ui_in[1], 2 = ui_in[2], 3 = ui_in[7]"
	default 0
	range 0 3

endif # LISA_SPI

config LISA_I2C
	bool "I2C master"
	default n
	select I2C
	---help---
		The chip's I2C master (ttsky26d src/lisa_i2c.v, peripheral
		0x220-0x226) as I2C bus 0 (lisa_i2cbus_initialize(0)): a byte at a
		time, polled, repeated starts between messages, 7-bit addresses.
		The pins come from the uio mux (debug register 0x1c, set by the
		host: 0x00fa is io mux mode 3 with SCL / SDA on uio[4] / uio[5],
		the Arty's JD pins 1 / 2 with SW2 up).

endif
```

## arch/lisa/src/lisa/Kconfig
```kconfig
#
# For a description of the syntax of this configuration file,
# see the file kconfig-language.txt in the NuttX tools repository.
#

if ARCH_CHIP_LISA

choice
	prompt "Toolchain Selection"
	default LISA_TOOLCHAIN_SDCC

config LISA_TOOLCHAIN_SDCC
	bool "sdcc -mlisa (lisa-tools/sdcc-lisa)"

endchoice

config LISA_SDCC_PATH
	string "sdcc build directory"
	default "../lisa-tools/sdcc-lisa/build"
	---help---
		The build directory of sdcc-lisa (bin/sdcc, share/sdcc/lib/lisa-rev2),
		relative to the NuttX top directory unless absolute.

config LISA_REV3
	bool "The third chip: 24-bit registers, a flat 8 MB data space"
	default y
	select ARCH_WIDE_HEAP
	---help---
		The twenty-four-bit chip (ttsky26d REV3.md): IX, SP and the return
		addresses are 24 bits, pointers 3 bytes (sdcc --rev3, the library
		lisa-rev3), the data space the flat 8 MB with no banks - one heap
		from the end of the data areas to the idle thread's stack, in
		regions of 64 KB (size_t is 16 bits), so MM_REGIONS has to cover
		the RAM (130 for 8 MB).  Without it the kernel is built for the
		second chip (sdcc --rev2, the task banks optional).

config LISA_TASK_BANKS
	bool "Task banks: each task's stack in a stack bank, its heap in a granule"
	default n
	depends on !LISA_REV3
	select ARCH_BANKED_TASKS
	select MM_KERNEL_HEAP
	---help---
		The second chip's data space (RESPIN 28) is the common 8 KB below
		0x2000, the data window 0x2000-0x3FFF on one of 32 granules of
		8 KB and the stack window 0x4000-0x7FFF on one of 16 banks of
		16 KB, by address.  With this option the kernel's data and heap
		stay in the common 8 KB, visible to every task, and each task
		gets a granule for the heap its malloc() draws from and a stack
		in a stack bank: a small stack shares a bank with other tasks'
		stacks, a stack of LISA_TASK_OWN_BANK_STACK bytes or more gets a
		bank of its own, and the task's heap then runs from 0x2000 up to
		its stack, 24 KB less the stack.  A pthread's stack comes from
		its group's heap; the kernel threads share bank 1 and granule 1
		with the idle thread.  A heap pointer is valid only under its
		own granule: tasks share memory through the kernel (pipes,
		files, message queues), not by pointer.  The kernel reaches a
		task's stack or heap through a visit on a scratch stack in the
		common 8 KB (lisa_bank_call).  /proc/meminfo lists the kernel
		heap, the calling task's heap, each stack bank and the total of
		all 31 granules.

		Without it the data space is the flat 32 KB: one heap, every
		stack in it.

config LISA_SCHED_TRACE
	bool "A context-switch trace and UART receive counters, read with xd"
	default n
	---help---
		A debugging aid: a ring of the last 64 context switches (the pid
		switched from, the pid switched to, how - 1 a switch, 2 + 16 x the
		irq an interrupt, 3 an exit - and the low byte of the tick) in
		g_swtrace with its index g_swidx, and in the UART driver counters
		of the bytes taken from the receive FIFO, the overruns seen and the
		receive interrupt disables and enables (g_lisa_rx_bytes, _ovr,
		_off, _on).  Read them with nsh's xd at the addresses nuttx.map
		gives (arch/lisa/src/nuttx.map).

config LISA_TASK_OWN_BANK_STACK
	int "Stack size from which a task gets a bank of its own"
	default 4096
	depends on LISA_TASK_BANKS
	---help---
		A task created with a stack of at least this many bytes takes a
		free stack bank for itself: the stack at the top, the task's heap
		from the data window up to it (24 KB less the stack).  A smaller
		stack goes to the first shared bank with room, a new one when none
		has, and the task's heap is its 8 KB granule.

endif
```

## boards/lisa/lisa/arty/Kconfig
```kconfig
#
# For a description of the syntax of this configuration file,
# see the file kconfig-language.txt in the NuttX tools repository.
#

if ARCH_BOARD_LISA_ARTY

config ARTY_SPIFLASH
	bool "SPI flash with smartfs"
	default n
	depends on LISA_SPI && MTD_SST25XX && MTD_SMART && FS_SMARTFS
	---help---
		An SST25VF064C on the SPI master's CS0 (Pmod JB3 = uo[3] CS0, JB5
		= uo[5] SCLK, JB6 = uo[6] MOSI, JA0 = ui_in[0] MISO; the host sets
		the uo_out mux, debug register 0x1b = 0x2880): board_late_initialize
		registers it as an MTD device, SMART over it as /dev/smart0 and
		mounts smartfs at ARTY_SPIFLASH_MOUNT.

config ARTY_OLED
	bool "SSD1309 128x64 I2C OLED"
	default n
	depends on LISA_I2C && LCD_SSD1306_I2C
	---help---
		An SSD1309 OLED on the I2C master in io mux mode 3 (the host sets
		debug register 0x1c = 0x00fa: arty_term.py M3=1; the Arty's SW2 up
		puts SCL / SDA on JD pins 1 / 2): board_lcd_initialize brings up
		the SSD1306 driver on I2C bus 0, board_late_initialize registers
		/dev/fb0 (VIDEO_FB with LCD_FRAMEBUFFER) and /dev/i2c0
		(I2C_DRIVER).

config ARTY_LCD_BACKPACK
	bool "HD44780 character LCD on a PCF8574 I2C backpack"
	default n
	depends on LISA_I2C && LCD_BACKPACK
	---help---
		A character LCD (20x4 by default) on a PCF8574 backpack on I2C
		bus 0, in io mux mode 3 (the host sets debug register 0x1c =
		0x00fa: arty_term.py M3=1; the Arty's SW2 up puts SCL / SDA on JD
		pins 1 / 2): board_late_initialize registers /dev/slcd0 with the
		YwRobot / SainSmart pin mapping (P0 RS, P1 RW, P2 E, P3 the
		backlight, P4-P7 D4-D7).  Mind the backpack's pull-ups: at 5 V they
		pull SDA / SCL to 5 V; power it from 3.3 V or remove them.

if ARTY_LCD_BACKPACK

config ARTY_LCD_BACKPACK_ADDR
	hex "The backpack's 7-bit I2C address"
	default 0x27
	---help---
		0x20-0x27 for a PCF8574, 0x38-0x3f for a PCF8574A.

config ARTY_LCD_BACKPACK_ROWS
	int "Rows"
	default 4

config ARTY_LCD_BACKPACK_COLS
	int "Columns"
	default 20

endif

config ARTY_SPIFLASH_MOUNT
	string "smartfs mount point"
	default "/mnt/flash"
	depends on ARTY_SPIFLASH

endif
```
